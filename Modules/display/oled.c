#include "display/oled.h"
#include <stddef.h>
#include <string.h>

static uint8_t Frame[8][OLED_WIDTH];
static OLED_WriteFn Send;
static uint8_t DeviceAddress,Ready,Flushing,Page,Column;

// Five vertical columns per glyph, least significant bit at the top.
// Small debug alphabet; lowercase is rendered uppercase, unsupported bytes as '?'.
static const char GlyphNames[]=" ABCDEFGHIJKLMNOPQRSTUVWXYZ0123456789+-./:[]?=_%~>";
static const uint8_t Glyphs[][5]={
    {0,0,0,0,0},
    {0x7e,0x11,0x11,0x11,0x7e},{0x7f,0x49,0x49,0x49,0x36},
    {0x3e,0x41,0x41,0x41,0x22},{0x7f,0x41,0x41,0x22,0x1c},
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    {0,0x41,0x22,0x14,0x08}
};
_Static_assert(sizeof(GlyphNames)-1==sizeof(Glyphs)/sizeof(Glyphs[0]),"Font table mismatch");

uint8_t OLED_Init(OLED_WriteFn Write, uint8_t Address)
{
    Ready=0;
    Flushing=0;
    Send=Write;
    DeviceAddress=Address;
    if(Send==NULL || Address>0x7fU)return 0;
    // 0x00 control byte precedes a stream of commands. Module spec: DB=30.
    static const uint8_t Init[]={0x00,0xae,0x2e,0x20,0x02,0x40,0x81,0xcf,
        0xa1,0xc8,0xa6,0xa8,0x3f,0xd3,0x00,0xd5,0x80,0xd9,0xf1,
        0xda,0x12,0xdb,0x30,0x8d,0x14,0xa4};
    if(!Send(DeviceAddress,Init,sizeof(Init)))return 0;
    memset(Frame,0,sizeof(Frame));
    Ready=1;
    return 1; // Display stays OFF until the first complete framebuffer is sent.
}
uint8_t OLED_IsReady(void) {return Ready;}
uint8_t OLED_IsFlushing(void) {return Flushing;}
void OLED_Clear(void) {if(!Flushing)memset(Frame,0,sizeof(Frame));}
void OLED_DrawPoint(int16_t X, int16_t Y, uint8_t On)
{
    if(Flushing || X<0 || X>=(int16_t)OLED_WIDTH || Y<0 || Y>=(int16_t)OLED_HEIGHT)return;
    uint8_t Mask=(uint8_t)(1U<<(Y&7));
    if(On)Frame[Y/8][X]|=Mask;
    else Frame[Y/8][X]&=(uint8_t)~Mask;
}
void OLED_DrawText(int16_t X, int16_t Y, const char *Text)
{
    if(Text==NULL || Flushing || X< -5 || X>=(int16_t)OLED_WIDTH || Y< -7 || Y>=(int16_t)OLED_HEIGHT)return;
    for(uint8_t n=0;n<22 && Text[n]!=0 && X<(int16_t)OLED_WIDTH;n++,X+=6)
    {
        char Ch=Text[n];
        if(Ch>='a' && Ch<='z')Ch=(char)(Ch-'a'+'A');
        const char *Match=strchr(GlyphNames,Ch);
        if(Match==NULL)Match=strchr(GlyphNames,'?');
        unsigned Index=(unsigned)(Match-GlyphNames);
        for(uint8_t Col=0;Col<6;Col++)
            for(uint8_t Row=0;Row<8;Row++)
                OLED_DrawPoint(X+Col,Y+Row,Col<5 && (Glyphs[Index][Col]&(1U<<Row)));
    }
}
uint8_t OLED_FlushBegin(void)
{
    if(!Ready || Flushing)return 0;
    Page=0;
    Column=0;
    Flushing=1;
    return 1;
}
uint8_t OLED_FlushStep(void)
{
    if(!Ready)return 0;
    if(!Flushing)return 1;
    // Explicit addressing on each chunk allows other I2C devices between steps.
    uint8_t Position[]={0x00,(uint8_t)(0xb0U+Page),(uint8_t)(Column&0x0fU),
        (uint8_t)(0x10U+(Column>>4))};
    uint8_t Data[33];
    Data[0]=0x40;
    memcpy(Data+1,&Frame[Page][Column],32);
    if(!Send(DeviceAddress,Position,sizeof(Position)) || !Send(DeviceAddress,Data,sizeof(Data)))goto Failure;
    if(Column==96)
    {
        Column=0;
        Page++;
    }
    else Column+=32;
    if(Page==8)
    {
        const uint8_t DisplayOn[]={0x00,0xaf};
        if(!Send(DeviceAddress,DisplayOn,sizeof(DisplayOn)))goto Failure;
        Flushing=0;
    }
    return 1;
Failure:
    Ready=0;
    Flushing=0;
    return 0;
}
